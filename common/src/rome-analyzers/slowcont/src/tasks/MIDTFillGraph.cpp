////////////////////////////////////////////////////////////////////////////////
//                                                                            //
// MIDTFillGraph                                                              //
//                                                                            //
// Begin_Html <!--
/*-->

<!--*/
// --> End_Html
//                                                                            //
//                                                                            //
// Please note: The following information is only correct after executing     //
// the ROMEBuilder.                                                           //
//                                                                            //
// This task accesses the following folders :                                 //
//     ODB                                                                    //
//                                                                            //
// This task contains the following graphs :                                  //
//    MyGraph                                                                 //
//                                                                            //
// The histograms/graph are created and saved automaticaly by the task.       //
//                                                                            //
// The following method can be used to get a handle of the histogram/graph :  //
//                                                                            //
// Get<Histogram/Graph Name>()                                                //
//                                                                            //
// For histogram/graph arrays use :                                           //
//                                                                            //
// Get<Histogram/Graph Name>At(Int_t index)                                   //
//                                                                            //
//                                                                            //
////////////////////////////////////////////////////////////////////////////////

/* Generated header file containing necessary includes                        */
#include "generated/MIDTFillGraphGeneratedIncludes.h"

////////////////////////////////////////////////////////////////////////////////
/*  This header was generated by ROMEBuilder. Manual changes above the        *
 * following line will be lost next time ROMEBuilder is executed.             */
/////////////////////////////////////----///////////////////////////////////////

#include "generated/MIDAnalyzer.h"
#include "tasks/MIDTFillGraph.h"
#include "ROMEiostream.h"
#include "TStyle.h"
#include "TROOT.h"
#include "TFile.h"
#include "TPad.h"
#include "TGraph.h"
#include <TTree.h>
#include "ROMEODBOfflineDataBase.h"
#include "MIDODB.h"
#include <TBranch.h>

// uncomment if you want to include headers of all folders
//#include "MIDAllFolders.h"

int   evID = 0.;
int   tStamp = 0;
float temp[8];
float capac[4];

static TFile *fTreeFile = NULL;
static TTree *fEventTree = NULL;
static TBranch *fEventBranch = NULL;

ClassImp(MIDTFillGraph)

//______________________________________________________________________________
void MIDTFillGraph::Init()
{
}

//______________________________________________________________________________
void MIDTFillGraph::BeginOfRun()
{
   TString treeFile = "data-out/sc_tree_run";
   treeFile += Form("%05i",gAnalyzer->GetODB()->GetRunNumber(),"");
   treeFile += ".root";

   fTreeFile = TFile::Open(treeFile.Data(), "RECREATE");   
   fTreeFile->cd();
   fEventTree = new TTree("g2slow","SLOW CONTROL DATA");
   fEventTree->SetAutoSave(300000000); // autosave when 300 Mbyte written.
   fEventTree->SetMaxVirtualSize(300000000); // 300 Mbyte

   //set branches.  should generalize to use var like nTempChan, nCapacChan, etc.
   fEventTree->Branch("Timestamp",&tStamp,"Timestamp/I");
   fEventTree->Branch("Temp0",&temp[0],"Temp0/F");
   fEventTree->Branch("Temp1",&temp[1],"Temp1/F");
   fEventTree->Branch("Temp2",&temp[2],"Temp2/F");
   fEventTree->Branch("Temp3",&temp[3],"Temp3/F");
   fEventTree->Branch("Temp4",&temp[4],"Temp4/F");
   fEventTree->Branch("Temp5",&temp[5],"Temp5/F");
   fEventTree->Branch("Temp6",&temp[6],"Temp6/F");
   fEventTree->Branch("Temp7",&temp[7],"Temp7/F");
   fEventTree->Branch("Capac0",&capac[0],"Capac0/F");
   fEventTree->Branch("Capac1",&capac[1],"Capac1/F");
   fEventTree->Branch("Capac2",&capac[2],"Capac2/F");
   fEventTree->Branch("Capac3",&capac[3],"Capac3/F");
}

//______________________________________________________________________________
void MIDTFillGraph::Event()
{

  gStyle->SetStatH(0.2);
  gStyle->SetStatW(0.6);
  gStyle->SetCanvasColor(0);
  gStyle->SetTitleFillColor(0);
  gStyle->SetTitleBorderSize(0);
  gStyle->SetStatColor(0);
  gStyle->SetHistLineWidth(0);

   if (IsMyGraphActive()) {
	  
	  tStamp = gAnalyzer->GetActiveDAQ()->GetTimeStamp();
      
      for (Int_t i = 0; i < gAnalyzer->GetMidasDAQ()->GetINPTBankEntries(); i++) {
         GetMyGraphAt(i)->SetPoint(GetMyGraphAt(i)->GetN(),gAnalyzer->GetActiveDAQ()->GetTimeStamp(),gAnalyzer->GetMidasDAQ()->GetINPTBankAt(i));

         if (i < gAnalyzer->GetGSP()->GetNChannels()) {//loop is redundant?
            //GetMyGraphAt(i)->SetPoint(GetMyGraphAt(i)->GetN(),gAnalyzer->GetActiveDAQ()->GetTimeStamp(),gAnalyzer->GetMidasDAQ()->GetINPTBankAt(i));
            GetMyGraphAt(i)->SetMarkerStyle(20);
            GetMyGraphAt(i)->SetMarkerColor(kRed);
            GetMyGraphAt(i)->SetLineColor(kBlue);
            GetMyGraphAt(i)->GetXaxis()->SetTimeDisplay(1);
            GetMyGraphAt(i)->GetXaxis()->SetTimeFormat("#splitline{%H:%M}{%d/%m} %F 1970-01-01 00:00:00");
            GetMyGraphAt(i)->GetXaxis()->SetTitle("");
            GetMyGraphAt(i)->GetYaxis()->SetTitle("ADC counts");
            GetMyGraphAt(i)->SetTitle(Form("Run #%d",gAnalyzer->GetODB()->GetRunNumber()));
            GetMyGraphAt(i)->GetYaxis()->CenterTitle(1);
            GetMyGraphAt(i)->GetXaxis()->SetLabelOffset(0.02);
            GetMyGraphAt(i)->GetXaxis()->SetTitleSize(0.05);
	        
	        //tree stuff
	        if (i<8) temp[i] = gAnalyzer->GetMidasDAQ()->GetINPTBankAt(i);
	        else capac[i-8] = gAnalyzer->GetMidasDAQ()->GetINPTBankAt(i);
	                 
         }
      }

      if (gAnalyzer->GetMidasDAQ()->GetINPTBankEntries() > 0) {
        fEventTree->Fill();
      }
   }
}

//______________________________________________________________________________
void MIDTFillGraph::EndOfRun()
{

TGraph *graphs[gAnalyzer->GetMidasDAQ()->GetINPTBankEntries()];
int n = 0;
for (int i=0; i<gAnalyzer->GetMidasDAQ()->GetINPTBankEntries(); i++){
  graphs[i] = new TGraph();
  for (int k=0; k<GetMyGraphAt(i)->GetN(); k++)
    graphs[i]->SetPoint(k,GetMyGraphAt(i)->GetX()[k],GetMyGraphAt(i)->GetY()[k]);
}

   fTreeFile->cd();

for (int i=0; i<gAnalyzer->GetMidasDAQ()->GetINPTBankEntries(); i++){
	if (i<8) graphs[i]->Write(Form("temperature_%d",i+1));
	else graphs[i]->Write(Form("capacitec_%d",i+1-8));
}	
fTreeFile->Write();
fTreeFile->Close();

}

//______________________________________________________________________________
void MIDTFillGraph::Terminate()
{
}

