////////////////////////////////////////////////////////////////////////////////
//                                                                            //
// MIDTFillGraph_CTEC                                                         //
//                                                                            //
// Begin_Html <!--
/*-->

<!--*/
// --> End_Html
//                                                                            //
//                                                                            //
// Please note: The following information is only correct after executing     //
// the ROMEBuilder.                                                           //
//                                                                            //
// This task accesses the following folders :                                 //
//     ODB                                                                    //
//                                                                            //
// This task contains the following graphs :                                  //
//    MyGraph_CTEC                                                            //
//                                                                            //
// The histograms/graph are created and saved automaticaly by the task.       //
//                                                                            //
// The following method can be used to get a handle of the histogram/graph :  //
//                                                                            //
// Get<Histogram/Graph Name>()                                                //
//                                                                            //
// For histogram/graph arrays use :                                           //
//                                                                            //
// Get<Histogram/Graph Name>At(Int_t index)                                   //
//                                                                            //
//                                                                            //
////////////////////////////////////////////////////////////////////////////////

/* Generated header file containing necessary includes                        */
#include "generated/MIDTFillGraph_CTECGeneratedIncludes.h"

////////////////////////////////////////////////////////////////////////////////
/*  This header was generated by ROMEBuilder. Manual changes above the        *
 * following line will be lost next time ROMEBuilder is executed.             */
/////////////////////////////////////----///////////////////////////////////////

#include "generated/MIDAnalyzer.h"
#include "tasks/MIDTFillGraph_CTEC.h"
#include "ROMEiostream.h"
#include "TStyle.h"
#include "TROOT.h"
#include "TFile.h"
#include "TPad.h"
#include "TGraph.h"
#include <TTree.h>
#include "ROMEODBOfflineDataBase.h"
#include "MIDODB.h"
#include <TBranch.h>

// uncomment if you want to include headers of all folders
//#include "MIDAllFolders.h"

int   evID = 0.;
int   tStamp_ctec = 0;
float cap[4];

static TFile *fTreeFile = NULL;
static TTree *fEventTree = NULL;
static TBranch *fEventBranch = NULL;

ClassImp(MIDTFillGraph_CTEC)

//______________________________________________________________________________
void MIDTFillGraph_CTEC::Init()
{
}

//______________________________________________________________________________
void MIDTFillGraph_CTEC::BeginOfRun()
{
   TString treeFile = "data-out/cap_tree_run";
   treeFile += Form("%05i",gAnalyzer->GetODB()->GetRunNumber(),"");
   treeFile += ".root";

   fTreeFile = TFile::Open(treeFile.Data(), "RECREATE");   
   fTreeFile->cd();
   fEventTree = new TTree("g2cap","SLOW CONTROL DATA");
   fEventTree->SetAutoSave(300000000); // autosave when 300 Mbyte written.
   fEventTree->SetMaxVirtualSize(300000000); // 300 Mbyte

   //set branches.  should generalize to use var like nTempChan, nCapacChan, etc.
   fEventTree->Branch("Timestamp",&tStamp_ctec,"Timestamp/I");
   fEventTree->Branch("cap_0",&cap[0],"Cap0/F");
   fEventTree->Branch("cap_1",&cap[1],"Cap1/F");
   fEventTree->Branch("cap_2",&cap[2],"Cap2/F");
   fEventTree->Branch("cap_3",&cap[3],"Cap3/F");
}

//______________________________________________________________________________
void MIDTFillGraph_CTEC::Event()
{

  gStyle->SetStatH(0.2);
  gStyle->SetStatW(0.6);
  gStyle->SetCanvasColor(0);
  gStyle->SetTitleFillColor(0);
  gStyle->SetTitleBorderSize(0);
  gStyle->SetStatColor(0);
  gStyle->SetHistLineWidth(0);

   if (IsMyGraph_CTECActive()) {
	  
	  tStamp_ctec = gAnalyzer->GetActiveDAQ()->GetTimeStamp();
          cout<<" time "<<tStamp_ctec<<" ctec entries: "<<gAnalyzer->GetMidasDAQ()->GetCTECBankEntries()<<endl;     
          //cout<<" NChannels_CTEC "<<gAnalyzer->GetGSP()->GetNChannels_CTEC()<<endl;
 
      for (Int_t i = 0; i < gAnalyzer->GetMidasDAQ()->GetCTECBankEntries(); i++) {
         //cout<<"i is "<<i<<" out of "<<gAnalyzer->GetMidasDAQ()->GetCTECBankEntries()<<" value "<<gAnalyzer->GetMidasDAQ()->GetCTECBankAt(i)<<endl;
         GetMyGraph_CTECAt(i)->SetPoint(GetMyGraph_CTECAt(i)->GetN(),gAnalyzer->GetActiveDAQ()->GetTimeStamp(),gAnalyzer->GetMidasDAQ()->GetCTECBankAt(i));

         if (i < gAnalyzer->GetGSP()->GetNChannels_CTEC()) {//loop is redundant?
            //GetMyGraph_CTECAt(i)->SetPoint(GetMyGraph_CTECAt(i)->GetN(),gAnalyzer->GetActiveDAQ()->GetTimeStamp(),gAnalyzer->GetMidasDAQ()->GetCTECBankAt(i));
            GetMyGraph_CTECAt(i)->SetMarkerStyle(20);
            GetMyGraph_CTECAt(i)->SetMarkerColor(kRed);
            GetMyGraph_CTECAt(i)->SetLineColor(kBlue);
            GetMyGraph_CTECAt(i)->GetXaxis()->SetTimeDisplay(1);
            GetMyGraph_CTECAt(i)->GetXaxis()->SetTimeFormat("#splitline{%H:%M}{%d/%m} %F 1970-01-01 00:00:00");
            GetMyGraph_CTECAt(i)->GetXaxis()->SetTitle("");
            GetMyGraph_CTECAt(i)->GetYaxis()->SetTitle("ADC counts");
            if (i==0) GetMyGraph_CTECAt(i)->SetTitle(Form("Run #%d, outer lower",gAnalyzer->GetODB()->GetRunNumber()));
            if (i==1) GetMyGraph_CTECAt(i)->SetTitle(Form("Run #%d, inner upper",gAnalyzer->GetODB()->GetRunNumber()));
            if (i==2) GetMyGraph_CTECAt(i)->SetTitle(Form("Run #%d, inner lower",gAnalyzer->GetODB()->GetRunNumber()));
            if (i==3) GetMyGraph_CTECAt(i)->SetTitle(Form("Run #%d, outer upper",gAnalyzer->GetODB()->GetRunNumber()));
            //GetMyGraph_CTECAt(i)->SetTitle(Form("Run #%d",gAnalyzer->GetODB()->GetRunNumber()));
            GetMyGraph_CTECAt(i)->GetYaxis()->CenterTitle(1);
            GetMyGraph_CTECAt(i)->GetXaxis()->SetLabelOffset(0.02);
            GetMyGraph_CTECAt(i)->GetXaxis()->SetTitleSize(0.05);
	        
	        //tree stuff
	        cap[i] = gAnalyzer->GetMidasDAQ()->GetCTECBankAt(i);
	                 
         }
      }
      
      if (gAnalyzer->GetMidasDAQ()->GetCTECBankEntries() > 0) {
         fEventTree->Fill();
      }
   }
}

//______________________________________________________________________________
void MIDTFillGraph_CTEC::EndOfRun()
{

TGraph *graphs[gAnalyzer->GetMidasDAQ()->GetCTECBankEntries()];
int n = 0;
for (int i=0; i<gAnalyzer->GetMidasDAQ()->GetCTECBankEntries(); i++){
  graphs[i] = new TGraph();
  for (int k=0; k<GetMyGraph_CTECAt(i)->GetN(); k++)
    graphs[i]->SetPoint(k,GetMyGraph_CTECAt(i)->GetX()[k],GetMyGraph_CTECAt(i)->GetY()[k]);
}

   fTreeFile->cd();

for (int i=0; i<gAnalyzer->GetMidasDAQ()->GetCTECBankEntries(); i++){
   if (i==0) graphs[i]->Write("cap_0");
   if (i==1) graphs[i]->Write("cap_1");
   if (i==2) graphs[i]->Write("cap_2");
   if (i==3) graphs[i]->Write("cap_3");
}
fTreeFile->Write();
fTreeFile->Close();

}

//______________________________________________________________________________
void MIDTFillGraph_CTEC::Terminate()
{
}

